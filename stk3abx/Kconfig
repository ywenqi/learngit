## stk3abx/Kconfig
```kconfig
#
# Makefile for stk8baxx sensor driver.
#
config INPUT_STK3ABX_I2C
	tristate "stk3ABX acceleration sensor support"
	depends on I2C
	help
	  Say Y here to enable support for the stk8baxx's
	  acceleration sensor stk3a5x.

	  To compile this driver as a module, choose M here: the
	  module will be called stk3a5x.
```
